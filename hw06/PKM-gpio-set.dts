/*
Name: Pushpendra kumar meena
Roll No.: B13132
Date: 02/11/15
*/
/dts-v1/;
/plugin/;
/{
	compatible = "ti,beaglebone", "ti,beaglebone-black";
		part-number = "PKM-GPIO-Test";
		version = "00A0";
			fragment@0 {
			target = <&am33xx_pinmux>;
			__overlay__ {
				pinctrl_test: PKM_GPIO_Test_Pins {
					pinctrl-single,pins = <
						0x164 0x37 /* P9_12 60 OUTPUT MODE7 - The LED Output */
					/* OUTPUT GPIO(mode7) 0x07 pulldown, 0x17 pullup, 0x?f no pullup/down */
		/* INPUT GPIO(mode7) 0x27 pulldown, 0x37 pullup, 0x?f no pullup/down */
			>;
			};
		};
	};
};
